/*
 * rng.c
 *
 * Created: 28/11/2014 14:29:36
 *  Author: paul.qureshi
 */ 

#include <avr/io.h>
#include <avr/pgmspace.h>

const __flash uint8_t rand_lut[256] =
{
    0x18,	0xC7,	0x0B,	0xF6,	0xFF,	0xB0,	0xAF,	0x2E,
    0x2D,	0xF7,	0xB1,	0xE2,	0x20,	0x26,	0x45,	0x08,
    0x53,	0xE6,	0x3D,	0xB3,	0xD4,	0x16,	0xD1,	0xCF,
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    0x6C,	0xCB,	0x25,	0x40,	0xFA,	0x80,	0xE1,	0x00
};


/**************************************************************************************************
** Get one sample from the ADC
*/
uint16_t rng_sample(void)
{
	ADCA.CH0.INTFLAGS = 0xFF;				// clear channel done flag
	ADCA.CH0.CTRL |= ADC_CH_START_bm;		// start conversion

	while (ADCA.CH0.INTFLAGS == 0)
		;

	return (ADCA.CH0.RES);
}

/**************************************************************************************************
** Generate random bytes
*/
void RNG_get_bytes(void *buffer, uint8_t buffer_size)
{
	uint8_t	*p = (uint8_t *)buffer;
	
	ADCA.CTRLA = ADC_FLUSH_bm;												// cancel any pending conversions, disable ADC
	NOP();

	// set up exactly how Atmel did when they measured their calibration value
	ADCA.CTRLB = ADC_RESOLUTION_12BIT_gc;									// unsigned conversion, produces result in range 0-2048
	ADCA.REFCTRL = ADC_REFSEL_INT1V_gc | ADC_TEMPREF_bm;					// use internal 1V reference, enable temperature reference source
	ADCA.CH0.CTRL =	ADC_CH_INPUTMODE_SINGLEENDED_gc;
	ADCA.CH0.MUXCTRL = ADC_CH_MUXPOS_PIN3_gc;
	ADCA.PRESCALER = ADC_PRESCALER_DIV4_gc;
	ADCA.CTRLA |= ADC_ENABLE_bm;
	rng_sample();

	while (buffer_size--)
	{
		WDR();

		uint8_t byte = 0;
		for (uint8_t i = 0; i < 8; i++)
		{
			byte <<= 1;
			byte |= rng_sample() & 1;
		}
		*p++ = rand_lut[byte];
	}

	ADCA.CTRLA = 0;
}
